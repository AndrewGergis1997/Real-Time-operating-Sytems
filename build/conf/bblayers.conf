## build/conf/bblayers.conf
```bitbake
# POKY_BBLAYERS_CONF_VERSION is increased each time build/conf/bblayers.conf
# changes incompatibly
POKY_BBLAYERS_CONF_VERSION = "2"

BBPATH = "${TOPDIR}"
BBFILES ?= ""

BBLAYERS ?= " \
  /home/student/11/poky/meta \
  /home/student/11/poky/meta-poky \
  /home/student/11/poky/meta-yocto-bsp \
  /home/student/11/meta-xilinx/meta-xilinx-bsp \
  /home/student/11/meta-xilinx/meta-xilinx-contrib \
  /home/student/11/meta-pynq \
  /home/student/11/meta-group11 \
  "
```

## meta-group11/conf/layer.conf
```bitbake
# We have a conf and classes directory, add to BBPATH
BBPATH .= ":${LAYERDIR}"

# We have recipes-* directories, add to BBFILES
BBFILES += "${LAYERDIR}/recipes-*/*/*.bb \
            ${LAYERDIR}/recipes-*/*/*.bbappend"

BBFILE_COLLECTIONS += "meta-group11"
BBFILE_PATTERN_meta-group11 = "^${LAYERDIR}/"
BBFILE_PRIORITY_meta-group11 = "6"
```
